## sdkconfig.defaults
```kconfig
# Configuración de la CPU
CONFIG_ESP_DEFAULT_CPU_FREQ_MHZ_240=y
CONFIG_ESP_DEFAULT_CPU_FREQ_MHZ=240

# Activación del Bluetooth
CONFIG_BT_ENABLED=y
CONFIG_BT_BLUEDROID_ENABLED=y
CONFIG_BT_CLASSIC_ENABLED=y
CONFIG_BT_HFP_AG_ENABLE=y

# Configuración de FreeRTOS
CONFIG_FREERTOS_HZ=1000
```
